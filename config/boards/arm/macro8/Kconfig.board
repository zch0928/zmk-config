## config/boards/arm/macro8/macro8_defconfig
```kconfig
CONFIG_SOC_SERIES_NRF52X=y
CONFIG_SOC_NRF52840_QIAA=y
CONFIG_BOARD_MACRO8=y

# Generate Intel HEX firmware artifacts instead of the default BIN fallback.
CONFIG_BUILD_OUTPUT_HEX=y
CONFIG_BUILD_OUTPUT_BIN=n

# 时钟：使用外部 32.768kHz 晶振
CONFIG_CLOCK_CONTROL_NRF_K32SRC_XTAL=y
CONFIG_CLOCK_CONTROL_NRF_K32SRC_20PPM=y

# USB
CONFIG_USB_DEVICE_STACK=y
CONFIG_USB_DEVICE_HID=y
CONFIG_ZMK_USB=y

# 蓝牙
CONFIG_BT=y
CONFIG_BT_CTLR=y
CONFIG_BT_MAX_CONN=5

# WS2812 RGB（GL5050）
CONFIG_SPI=y
CONFIG_WS2812_STRIP=y
CONFIG_WS2812_STRIP_SPI=y

# ADC 电池检测
CONFIG_ADC=y

# GPIO
CONFIG_GPIO=y
```
